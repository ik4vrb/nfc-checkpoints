## CMakeLists.txt
```
#
# Copyright (c) 2018 Nordic Semiconductor
#
# SPDX-License-Identifier: LicenseRef-Nordic-5-Clause
#

cmake_minimum_required(VERSION 3.20.0)
find_package(Zephyr REQUIRED HINTS $ENV{ZEPHYR_BASE})
project(NONE)

FILE(GLOB app_sources src/*.c)
# NORDIC SDK APP START
target_sources(app  PRIVATE ${app_sources})
# NORDIC SDK APP END
```

## prj.conf
```kconfig
#
# Copyright (c) 2019 Nordic Semiconductor ASA
#
# SPDX-License-Identifier: LicenseRef-Nordic-5-Clause
#
CONFIG_BT=y
CONFIG_BT_GATT_DYNAMIC_DB=y
CONFIG_BT_PERIPHERAL=y
CONFIG_BT_GATT_CLIENT=y
CONFIG_BT_MAX_CONN=5

CONFIG_BT_BUF_ACL_RX_SIZE=251
CONFIG_BT_ATT_PREPARE_COUNT=2
CONFIG_BT_CONN_TX_MAX=10
CONFIG_BT_L2CAP_TX_BUF_COUNT=10
CONFIG_BT_L2CAP_TX_MTU=247

CONFIG_NCS_SAMPLES_DEFAULTS=y

CONFIG_NFC_T4T_NRFXLIB=y

CONFIG_NFC_NDEF=y
CONFIG_NFC_NDEF_MSG=y
CONFIG_NFC_NDEF_RECORD=y
CONFIG_NFC_NDEF_URI_REC=y
CONFIG_NFC_NDEF_URI_MSG=y

CONFIG_MPU_ALLOW_FLASH_WRITE=y
CONFIG_FLASH=y
CONFIG_FLASH_PAGE_LAYOUT=y
CONFIG_NVS=y
CONFIG_DK_LIBRARY=y
```

## src/main.c
```c
/*
 * Copyright (c) 2018 Nordic Semiconductor ASA
 *
 * SPDX-License-Identifier: LicenseRef-Nordic-5-Clause
 */

/** @file
 *
 * @defgroup nfc_writable_ndef_msg_example_main main.c
 * @{
 * @ingroup nfc_writable_ndef_msg_example
 * @brief The application main file of NFC writable NDEF message example.
 *
 */



#include <zephyr/kernel.h>
#include <zephyr/sys/reboot.h>
#include <stdbool.h>
#include <nfc_t4t_lib.h>

#include <nfc/ndef/msg.h>
#include <nfc/t4t/ndef_file.h>

#include <dk_buttons_and_leds.h>

#include "ndef_file_m.h"

#include <zephyr/types.h>
#include <zephyr/drivers/sensor.h>
#include <stddef.h>
#include <string.h>
#include <errno.h>
#include <zephyr/sys/printk.h>
#include <zephyr/sys/byteorder.h>
#include <zephyr/kernel.h>
#include <stdio.h>

#include <zephyr/device.h>
#include <zephyr/drivers/gpio.h>
#include <zephyr/sys/util.h>
#include <inttypes.h>

#include <zephyr/bluetooth/bluetooth.h>
#include <zephyr/bluetooth/gap.h>
#include <zephyr/bluetooth/hci.h>
#include <zephyr/bluetooth/conn.h>
#include <zephyr/bluetooth/uuid.h>
#include <zephyr/bluetooth/gatt.h>

#define LAB2_SERVICE_UUID BT_UUID_128_ENCODE(0xBDFC9792, 0x8234, 0x405E, 0xAE02, 0x35EF3274B299)

const char msg1[] = "User Check-in";
const char msg2[] = "User Access Info";
const char msg3[] = "User Access Quiz";
const char msg4[] = "User Access Survey";
const char* const bt_notifs[] = { msg1, msg2, msg3, msg4};

bool notify_scan = false;

// Set up the advertisement data.
#define DEVICE_NAME "NFC_Proj_18"
#define DEVICE_NAME_LEN (sizeof(DEVICE_NAME) - 1)

static const struct bt_data ad[] = {
    BT_DATA(BT_DATA_NAME_COMPLETE, DEVICE_NAME, DEVICE_NAME_LEN),
	BT_DATA_BYTES(BT_DATA_UUID128_ALL, LAB2_SERVICE_UUID)
};

static void ccc_changed(const struct bt_gatt_attr *attr,
				       uint16_t value)
{
	ARG_UNUSED(attr);

	bool notif_enabled = (value == BT_GATT_CCC_NOTIFY);

	printk("CCC Notifications %s", notif_enabled ? "enabled" : "disabled");
}

BT_GATT_SERVICE_DEFINE(lab2_service,
	BT_GATT_PRIMARY_SERVICE(
		BT_UUID_DECLARE_128(LAB2_SERVICE_UUID)
	),
	BT_GATT_CHARACTERISTIC(BT_UUID_DECLARE_16(0x0001), BT_GATT_CHRC_NOTIFY,
			       BT_GATT_PERM_READ, NULL, NULL, bt_notifs[0]),
	BT_GATT_CCC(ccc_changed,
		    BT_GATT_PERM_READ | BT_GATT_PERM_WRITE),
);

#define NFC_FIELD_LED		DK_ALL_LEDS_MSK
#define NFC_WRITE_LED		DK_ALL_LEDS_MSK
#define NFC_READ_LED		DK_ALL_LEDS_MSK

#define NDEF_RESTORE_BTN_MSK	DK_BTN1_MSK

static char url_c0[] = "Check-In";
static char url_c1[] = "Info";
static char url_c2[] = "Quiz";
static char url_c3[] = "Survey";

static char* url_cat[] = {url_c0, url_c1, url_c2, url_c3 };
static uint8_t ndef_msg_buf[CONFIG_NDEF_FILE_SIZE]; /**< Buffer for NDEF file. */

enum {
	FLASH_WRITE_FINISHED,
	FLASH_BUF_PREP_STARTED,
	FLASH_BUF_PREP_FINISHED,
	FLASH_WRITE_STARTED,
};
static atomic_t op_flags;
static uint8_t flash_buf[CONFIG_NDEF_FILE_SIZE]; /**< Buffer for flash update. */
static uint8_t flash_buf_len; /**< Length of the flash buffer. */

static void flash_buffer_prepare(size_t data_length)
{
	if (atomic_cas(&op_flags, FLASH_WRITE_FINISHED,
			FLASH_BUF_PREP_STARTED)) {
		flash_buf_len = data_length + NFC_NDEF_FILE_NLEN_FIELD_SIZE;
		memcpy(flash_buf, ndef_msg_buf, sizeof(flash_buf));

		atomic_set(&op_flags, FLASH_BUF_PREP_FINISHED);
	} else {
		printk("Flash update pending. Discarding new data...\n");
	}

}

int url_id = 0;

/**
 * @brief Callback function for handling NFC events.
 */
static void nfc_callback(void *context,
			 nfc_t4t_event_t event,
			 const uint8_t *data,
			 size_t data_length,
			 uint32_t flags)
{
	ARG_UNUSED(context);
	ARG_UNUSED(data);
	ARG_UNUSED(flags);

	switch (event) {
	case NFC_T4T_EVENT_FIELD_ON:
		//dk_set_led_on(NFC_FIELD_LED);
		dk_set_leds( NFC_FIELD_LED );
		break;

	case NFC_T4T_EVENT_FIELD_OFF:
		dk_set_leds( DK_NO_LEDS_MSK );
		dk_set_led_on(url_id==0?DK_LED1:url_id==1?DK_LED2:url_id==2?DK_LED3:DK_LED4);
		break;

	case NFC_T4T_EVENT_NDEF_READ:
		//dk_set_led_on(NFC_READ_LED);
		dk_set_leds(NFC_READ_LED);
		printk( "User accessed '%s' portal\n", url_cat[url_id]);
		notify_scan = true;
		break;

	case NFC_T4T_EVENT_NDEF_UPDATED:
		if (data_length > 0) {
			//dk_set_led_on(NFC_WRITE_LED);
			dk_set_leds(NFC_WRITE_LED);
			flash_buffer_prepare(data_length);
		}
		break;

	default:
		break;
	}
	// printk( "%d\n", event );
	//for (int i=0; i<data_length; i++ )
	//  printk( "%2x ", data[i]);
	//printk( "\n" );
}

static int board_init(void)
{
	int err;

	err = dk_buttons_init(NULL);
	if (err) {
		printk("Cannot init buttons (err: %d)\n", err);
		return err;
	}

	err = dk_leds_init();
	if (err) {
		printk("Cannot init LEDs (err: %d)\n", err);
	}

	return err;
}

static void bt_ready(int err)
{
	if (err) {
		printk("Bluetooth init failed (err %d)\n", err);
		return;
	}

	printk("Bluetooth initialized\n");

	err = bt_le_adv_start(BT_LE_ADV_CONN, ad, ARRAY_SIZE(ad), NULL, 0);
	if (err) {
		printk("Advertising failed to start (err %d)\n", err);
		return;
	}
}

/**
 * @brief   Function for application main entry.
 */
int main(void)
{
	printk("Starting Nordic NFC Writable NDEF Message example\n");

	/* Configure LED-pins as outputs. */
	if (board_init() < 0) {
		printk("Cannot initialize board!\n");
		goto fail;
	}
	/* Initialize NVS. */
	if (ndef_file_setup() < 0) {
		printk("Cannot setup NDEF file!\n");
		goto fail;
	}
	/* Load NDEF message from the flash file. */
	if (ndef_file_load(url_id, ndef_msg_buf, sizeof(ndef_msg_buf)) < 0) {
		printk("Cannot load NDEF file!\n");
		goto fail;
	}

	/* Restore default NDEF message if button is pressed. */
	uint32_t button_state;

	dk_read_buttons(&button_state, NULL);
	if (button_state & NDEF_RESTORE_BTN_MSK) {
		if (ndef_restore_default(url_id, ndef_msg_buf,
					 sizeof(ndef_msg_buf)) < 0) {
			printk("Cannot flash NDEF message!\n");
			goto fail;
		}
		printk("Default NDEF message restored!\n");
	}
	/* Set up NFC */
	int err = nfc_t4t_setup(nfc_callback, NULL);

	if (err < 0) {
		printk("Cannot setup t4t library!\n");
		goto fail;
	}
	/* Run Read-Write mode for Type 4 Tag platform */
	if (nfc_t4t_ndef_rwpayload_set(ndef_msg_buf,
				       sizeof(ndef_msg_buf)) < 0) {
		printk("Cannot set payload!\n");
		goto fail;
	}
	/* Start sensing NFC field */
	if (nfc_t4t_emulation_start() < 0) {
		printk("Cannot start emulation!\n");
		goto fail;
	}
	printk("Starting NFC Writable NDEF Message example\n");
	dk_set_led_on(url_id==0?DK_LED1:url_id==1?DK_LED2:url_id==2?DK_LED3:DK_LED4);

	int err_2;

	err_2 = bt_enable(bt_ready);
	if (err_2) {
		printk("Bluetooth init failed (err %d)\n", err_2);
		return;
	}

	while (true) {
		/*if (atomic_cas(&op_flags, FLASH_BUF_PREP_FINISHED,
				FLASH_WRITE_STARTED)) {
			if (ndef_file_update(0, flash_buf, flash_buf_len) < 0) {
				printk("Cannot flash NDEF message!\n");
			} else {
				printk("NDEF message successfully flashed.\n");
			}

			atomic_set(&op_flags, FLASH_WRITE_FINISHED);
		}*/
		bool seturl = false;
		dk_read_buttons(&button_state, NULL);
		if ( url_id != 0 && ( button_state & DK_BTN1_MSK ) )
		{
            url_id = 0;
			seturl = true;
		}
		if ( url_id != 1 && ( button_state & DK_BTN2_MSK ) )
		{
            url_id = 1;
			seturl = true;
		}
		if ( url_id != 2 && ( button_state & DK_BTN3_MSK ) )
		{
            url_id = 2;
			seturl = true;
		}
		if ( url_id != 3 && ( button_state & DK_BTN4_MSK ) )
		{
            url_id = 3;
			seturl = true;
		}
		if ( seturl )
		{
			if (nfc_t4t_emulation_stop() < 0) {
				printk("Cannot start emulation!\n");
				goto fail;
			}
			if (ndef_restore_default(url_id, ndef_msg_buf,
						sizeof(ndef_msg_buf)) < 0) {
				printk("Cannot flash NDEF message!\n");
				goto fail;
			}
			if (nfc_t4t_ndef_rwpayload_set(ndef_msg_buf,
					sizeof(ndef_msg_buf)) < 0) {
				printk("Cannot set payload!\n");
				goto fail;
			}
			if (nfc_t4t_emulation_start() < 0) {
				printk("Cannot start emulation!\n");
				goto fail;
			}
			dk_set_leds( DK_NO_LEDS_MSK );
			dk_set_led_on(url_id==0?DK_LED1:url_id==1?DK_LED2:url_id==2?DK_LED3:DK_LED4);

			printk("Switch URL-%d (%s) done.\n", url_id+1, url_cat[url_id] );			 
		}

        if ( notify_scan )
		{
			bt_gatt_notify(NULL, &lab2_service.attrs[1], (bt_notifs[url_id]), strlen(bt_notifs[url_id]));
		    notify_scan = false;
		}

		__WFE();
	}

fail:
	#if CONFIG_REBOOT
		sys_reboot(SYS_REBOOT_COLD);
	#endif /* CONFIG_REBOOT */
		return -EIO;
}
/** @} */
```

## src/gatt.h
```c
/*
 * Copyright (c) 2015-2016 Intel Corporation
 *
 * SPDX-License-Identifier: Apache-2.0
 */
#ifndef ZEPHYR_INCLUDE_BLUETOOTH_GATT_H_
#define ZEPHYR_INCLUDE_BLUETOOTH_GATT_H_
 
#include <stdint.h>
#include <stddef.h>
 
#include <sys/types.h>
 
#include <zephyr/sys/slist.h>
#include <zephyr/sys/util.h>
#include <zephyr/bluetooth/conn.h>
#include <zephyr/bluetooth/uuid.h>
#include <zephyr/bluetooth/att.h>
 
#ifdef __cplusplus
extern "C" {
#endif
 
enum bt_gatt_perm {
        BT_GATT_PERM_NONE = 0,
 
        BT_GATT_PERM_READ = BIT(0),
 
        BT_GATT_PERM_WRITE = BIT(1),
 
        BT_GATT_PERM_READ_ENCRYPT = BIT(2),
 
        BT_GATT_PERM_WRITE_ENCRYPT = BIT(3),
 
        BT_GATT_PERM_READ_AUTHEN = BIT(4),
 
        BT_GATT_PERM_WRITE_AUTHEN = BIT(5),
 
        BT_GATT_PERM_PREPARE_WRITE = BIT(6),
 
        BT_GATT_PERM_READ_LESC = BIT(7),
 
        BT_GATT_PERM_WRITE_LESC = BIT(8),
};
 
#define BT_GATT_ERR(_att_err) (-(_att_err))
 
enum {
        BT_GATT_WRITE_FLAG_PREPARE = BIT(0),
 
        BT_GATT_WRITE_FLAG_CMD = BIT(1),
 
        BT_GATT_WRITE_FLAG_EXECUTE = BIT(2),
};
 
/* Forward declaration of GATT Attribute structure */
struct bt_gatt_attr;
 
typedef ssize_t (*bt_gatt_attr_read_func_t)(struct bt_conn *conn,
                                            const struct bt_gatt_attr *attr,
                                            void *buf, uint16_t len,
                                            uint16_t offset);
 
typedef ssize_t (*bt_gatt_attr_write_func_t)(struct bt_conn *conn,
                                             const struct bt_gatt_attr *attr,
                                             const void *buf, uint16_t len,
                                             uint16_t offset, uint8_t flags);
 
struct bt_gatt_attr {
        const struct bt_uuid *uuid;
        bt_gatt_attr_read_func_t read;
        bt_gatt_attr_write_func_t write;
        void *user_data;
        uint16_t handle;
        uint16_t perm;
};
 
struct bt_gatt_service_static {
        const struct bt_gatt_attr *attrs;
        size_t attr_count;
};
 
struct bt_gatt_service {
        struct bt_gatt_attr *attrs;
        size_t attr_count;
 
        sys_snode_t node;
};
 
struct bt_gatt_service_val {
        const struct bt_uuid *uuid;
        uint16_t end_handle;
};
 
struct bt_gatt_include {
        const struct bt_uuid *uuid;
        uint16_t start_handle;
        uint16_t end_handle;
};
 
struct bt_gatt_cb {
        void (*att_mtu_updated)(struct bt_conn *conn, uint16_t tx, uint16_t rx);
 
        sys_snode_t node;
};
 
#define BT_GATT_CHRC_BROADCAST                  0x01
#define BT_GATT_CHRC_READ                       0x02
#define BT_GATT_CHRC_WRITE_WITHOUT_RESP         0x04
#define BT_GATT_CHRC_WRITE                      0x08
#define BT_GATT_CHRC_NOTIFY                     0x10
#define BT_GATT_CHRC_INDICATE                   0x20
#define BT_GATT_CHRC_AUTH                       0x40
#define BT_GATT_CHRC_EXT_PROP                   0x80
 
struct bt_gatt_chrc {
        const struct bt_uuid *uuid;
        uint16_t value_handle;
        uint8_t properties;
};
 
#define BT_GATT_CEP_RELIABLE_WRITE              0x0001
#define BT_GATT_CEP_WRITABLE_AUX                0x0002
 
struct bt_gatt_cep {
        uint16_t properties;
};
 
#define BT_GATT_CCC_NOTIFY                      0x0001
#define BT_GATT_CCC_INDICATE                    0x0002
 
struct bt_gatt_ccc {
        uint16_t flags;
};
 
#define BT_GATT_SCC_BROADCAST                   0x0001
 
struct bt_gatt_scc {
        uint16_t flags;
};
 
struct bt_gatt_cpf {
        uint8_t format;
        int8_t exponent;
        uint16_t unit;
        uint8_t name_space;
        uint16_t description;
};
 
void bt_gatt_cb_register(struct bt_gatt_cb *cb);
 
int bt_gatt_service_register(struct bt_gatt_service *svc);
 
int bt_gatt_service_unregister(struct bt_gatt_service *svc);
 
bool bt_gatt_service_is_registered(const struct bt_gatt_service *svc);
 
enum {
        BT_GATT_ITER_STOP = 0,
        BT_GATT_ITER_CONTINUE,
};
 
typedef uint8_t (*bt_gatt_attr_func_t)(const struct bt_gatt_attr *attr,
                                       uint16_t handle,
                                       void *user_data);
 
void bt_gatt_foreach_attr_type(uint16_t start_handle, uint16_t end_handle,
                               const struct bt_uuid *uuid,
                               const void *attr_data, uint16_t num_matches,
                               bt_gatt_attr_func_t func,
                               void *user_data);
 
static inline void bt_gatt_foreach_attr(uint16_t start_handle, uint16_t end_handle,
                                        bt_gatt_attr_func_t func,
                                        void *user_data)
{
        bt_gatt_foreach_attr_type(start_handle, end_handle, NULL, NULL, 0, func,
                                  user_data);
}
 
struct bt_gatt_attr *bt_gatt_attr_next(const struct bt_gatt_attr *attr);
 
struct bt_gatt_attr *bt_gatt_find_by_uuid(const struct bt_gatt_attr *attr,
                                          uint16_t attr_count,
                                          const struct bt_uuid *uuid);
 
uint16_t bt_gatt_attr_get_handle(const struct bt_gatt_attr *attr);
 
uint16_t bt_gatt_attr_value_handle(const struct bt_gatt_attr *attr);
 
ssize_t bt_gatt_attr_read(struct bt_conn *conn, const struct bt_gatt_attr *attr,
                          void *buf, uint16_t buf_len, uint16_t offset,
                          const void *value, uint16_t value_len);
 
ssize_t bt_gatt_attr_read_service(struct bt_conn *conn,
                                  const struct bt_gatt_attr *attr,
                                  void *buf, uint16_t len, uint16_t offset);
 
#define BT_GATT_SERVICE_DEFINE(_name, ...)                              \
        const struct bt_gatt_attr attr_##_name[] = { __VA_ARGS__ };     \
        const STRUCT_SECTION_ITERABLE(bt_gatt_service_static, _name) =  \
                                        BT_GATT_SERVICE(attr_##_name)
 
#define _BT_GATT_ATTRS_ARRAY_DEFINE(n, _instances, _attrs_def)  \
        static struct bt_gatt_attr attrs_##n[] = _attrs_def(_instances[n])
 
#define _BT_GATT_SERVICE_ARRAY_ITEM(_n, _) BT_GATT_SERVICE(attrs_##_n)
 
#define BT_GATT_SERVICE_INSTANCE_DEFINE(                                 \
        _name, _instances, _instance_num, _attrs_def)                    \
        BUILD_ASSERT(ARRAY_SIZE(_instances) == _instance_num,            \
                "The number of array elements does not match its size"); \
        LISTIFY(_instance_num, _BT_GATT_ATTRS_ARRAY_DEFINE, (;),         \
                _instances, _attrs_def);                                 \
        static struct bt_gatt_service _name[] = {                        \
                LISTIFY(_instance_num, _BT_GATT_SERVICE_ARRAY_ITEM, (,)) \
        }
 
#define BT_GATT_SERVICE(_attrs)                                         \
{                                                                       \
        .attrs = _attrs,                                                \
        .attr_count = ARRAY_SIZE(_attrs),                               \
}
 
#define BT_GATT_PRIMARY_SERVICE(_service)                               \
        BT_GATT_ATTRIBUTE(BT_UUID_GATT_PRIMARY, BT_GATT_PERM_READ,      \
                         bt_gatt_attr_read_service, NULL, _service)
 
#define BT_GATT_SECONDARY_SERVICE(_service)                             \
        BT_GATT_ATTRIBUTE(BT_UUID_GATT_SECONDARY, BT_GATT_PERM_READ,    \
                         bt_gatt_attr_read_service, NULL, _service)
 
ssize_t bt_gatt_attr_read_included(struct bt_conn *conn,
                                   const struct bt_gatt_attr *attr,
                                   void *buf, uint16_t len, uint16_t offset);
 
#define BT_GATT_INCLUDE_SERVICE(_service_incl)                          \
        BT_GATT_ATTRIBUTE(BT_UUID_GATT_INCLUDE, BT_GATT_PERM_READ,      \
                          bt_gatt_attr_read_included, NULL, _service_incl)
 
ssize_t bt_gatt_attr_read_chrc(struct bt_conn *conn,
                               const struct bt_gatt_attr *attr, void *buf,
                               uint16_t len, uint16_t offset);
 
#define BT_GATT_CHRC_INIT(_uuid, _handle, _props) \
{                                                 \
        .uuid = _uuid,                            \
        .value_handle = _handle,                  \
        .properties = _props,                     \
}
 
#define BT_GATT_CHARACTERISTIC(_uuid, _props, _perm, _read, _write, _user_data) \
        BT_GATT_ATTRIBUTE(BT_UUID_GATT_CHRC, BT_GATT_PERM_READ,                 \
                          bt_gatt_attr_read_chrc, NULL,                         \
                          ((struct bt_gatt_chrc[]) {                            \
                                BT_GATT_CHRC_INIT(_uuid, 0U, _props),           \
                                                   })),                         \
        BT_GATT_ATTRIBUTE(_uuid, _perm, _read, _write, _user_data)
 
#if defined(CONFIG_BT_SETTINGS_CCC_LAZY_LOADING)
        #define BT_GATT_CCC_MAX (CONFIG_BT_MAX_CONN)
#elif defined(CONFIG_BT_CONN)
        #define BT_GATT_CCC_MAX (CONFIG_BT_MAX_PAIRED + CONFIG_BT_MAX_CONN)
#else
        #define BT_GATT_CCC_MAX 0
#endif
 
struct bt_gatt_ccc_cfg {
        uint8_t id;
        bt_addr_le_t peer;
        uint16_t value;
};
 
struct _bt_gatt_ccc {
        struct bt_gatt_ccc_cfg cfg[BT_GATT_CCC_MAX];
 
        uint16_t value;
 
        void (*cfg_changed)(const struct bt_gatt_attr *attr, uint16_t value);
 
        ssize_t (*cfg_write)(struct bt_conn *conn,
                             const struct bt_gatt_attr *attr, uint16_t value);
 
        bool (*cfg_match)(struct bt_conn *conn,
                          const struct bt_gatt_attr *attr);
};
 
ssize_t bt_gatt_attr_read_ccc(struct bt_conn *conn,
                              const struct bt_gatt_attr *attr, void *buf,
                              uint16_t len, uint16_t offset);
 
ssize_t bt_gatt_attr_write_ccc(struct bt_conn *conn,
                               const struct bt_gatt_attr *attr, const void *buf,
                               uint16_t len, uint16_t offset, uint8_t flags);
 
 
#define BT_GATT_CCC_INITIALIZER(_changed, _write, _match) \
        {                                            \
                .cfg = {},                           \
                .cfg_changed = _changed,             \
                .cfg_write = _write,                 \
                .cfg_match = _match,                 \
        }
 
#define BT_GATT_CCC_MANAGED(_ccc, _perm)                                \
        BT_GATT_ATTRIBUTE(BT_UUID_GATT_CCC, _perm,                      \
                        bt_gatt_attr_read_ccc, bt_gatt_attr_write_ccc,  \
                        _ccc)
 
#define BT_GATT_CCC(_changed, _perm)                            \
        BT_GATT_CCC_MANAGED(((struct _bt_gatt_ccc[])                    \
                {BT_GATT_CCC_INITIALIZER(_changed, NULL, NULL)}), _perm)
 
ssize_t bt_gatt_attr_read_cep(struct bt_conn *conn,
                              const struct bt_gatt_attr *attr, void *buf,
                              uint16_t len, uint16_t offset);
 
#define BT_GATT_CEP(_value)                                             \
        BT_GATT_DESCRIPTOR(BT_UUID_GATT_CEP, BT_GATT_PERM_READ,         \
                          bt_gatt_attr_read_cep, NULL, (void *)_value)
 
ssize_t bt_gatt_attr_read_cud(struct bt_conn *conn,
                              const struct bt_gatt_attr *attr, void *buf,
                              uint16_t len, uint16_t offset);
 
#define BT_GATT_CUD(_value, _perm)                                      \
        BT_GATT_DESCRIPTOR(BT_UUID_GATT_CUD, _perm, bt_gatt_attr_read_cud, \
                           NULL, (void *)_value)
 
ssize_t bt_gatt_attr_read_cpf(struct bt_conn *conn,
                              const struct bt_gatt_attr *attr, void *buf,
                              uint16_t len, uint16_t offset);
 
#define BT_GATT_CPF(_value)                                             \
        BT_GATT_DESCRIPTOR(BT_UUID_GATT_CPF, BT_GATT_PERM_READ,         \
                          bt_gatt_attr_read_cpf, NULL, (void *)_value)
 
#define BT_GATT_DESCRIPTOR(_uuid, _perm, _read, _write, _user_data)     \
        BT_GATT_ATTRIBUTE(_uuid, _perm, _read, _write, _user_data)
 
#define BT_GATT_ATTRIBUTE(_uuid, _perm, _read, _write, _user_data)      \
{                                                                       \
        .uuid = _uuid,                                                  \
        .read = _read,                                                  \
        .write = _write,                                                \
        .user_data = _user_data,                                        \
        .handle = 0,                                                    \
        .perm = _perm,                                                  \
}
 
typedef void (*bt_gatt_complete_func_t) (struct bt_conn *conn, void *user_data);
 
struct bt_gatt_notify_params {
        const struct bt_uuid *uuid;
        const struct bt_gatt_attr *attr;
        const void *data;
        uint16_t len;
        bt_gatt_complete_func_t func;
        void *user_data;
#if defined(CONFIG_BT_EATT)
        enum bt_att_chan_opt chan_opt;
#endif /* CONFIG_BT_EATT */
};
 
int bt_gatt_notify_cb(struct bt_conn *conn,
                      struct bt_gatt_notify_params *params);
 
int bt_gatt_notify_multiple(struct bt_conn *conn,
                            uint16_t num_params,
                            struct bt_gatt_notify_params params[]);
 
static inline int bt_gatt_notify(struct bt_conn *conn,
                                 const struct bt_gatt_attr *attr,
                                 const void *data, uint16_t len)
{
        struct bt_gatt_notify_params params;
 
        memset(&params, 0, sizeof(params));
 
        params.attr = attr;
        params.data = data;
        params.len = len;
#if defined(CONFIG_BT_EATT)
        params.chan_opt = BT_ATT_CHAN_OPT_NONE;
#endif /* CONFIG_BT_EATT */
 
        return bt_gatt_notify_cb(conn, &params);
}
 
static inline int bt_gatt_notify_uuid(struct bt_conn *conn,
                                      const struct bt_uuid *uuid,
                                      const struct bt_gatt_attr *attr,
                                      const void *data, uint16_t len)
{
        struct bt_gatt_notify_params params;
 
        memset(&params, 0, sizeof(params));
 
        params.uuid = uuid;
        params.attr = attr;
        params.data = data;
        params.len = len;
#if defined(CONFIG_BT_EATT)
        params.chan_opt = BT_ATT_CHAN_OPT_NONE;
#endif /* CONFIG_BT_EATT */
 
        return bt_gatt_notify_cb(conn, &params);
}
 
/* Forward declaration of the bt_gatt_indicate_params structure */
struct bt_gatt_indicate_params;
 
typedef void (*bt_gatt_indicate_func_t)(struct bt_conn *conn,
                                        struct bt_gatt_indicate_params *params,
                                        uint8_t err);
 
typedef void (*bt_gatt_indicate_params_destroy_t)(
                struct bt_gatt_indicate_params *params);
 
struct bt_gatt_indicate_params {
        const struct bt_uuid *uuid;
        const struct bt_gatt_attr *attr;
        bt_gatt_indicate_func_t func;
        bt_gatt_indicate_params_destroy_t destroy;
        const void *data;
        uint16_t len;
        uint8_t _ref;
#if defined(CONFIG_BT_EATT)
        enum bt_att_chan_opt chan_opt;
#endif /* CONFIG_BT_EATT */
};
 
int bt_gatt_indicate(struct bt_conn *conn,
                     struct bt_gatt_indicate_params *params);
 
 
bool bt_gatt_is_subscribed(struct bt_conn *conn,
                           const struct bt_gatt_attr *attr, uint16_t ccc_type);
 
uint16_t bt_gatt_get_mtu(struct bt_conn *conn);
 
struct bt_gatt_exchange_params {
        void (*func)(struct bt_conn *conn, uint8_t err,
                     struct bt_gatt_exchange_params *params);
};
 
int bt_gatt_exchange_mtu(struct bt_conn *conn,
                         struct bt_gatt_exchange_params *params);
 
struct bt_gatt_discover_params;
 
typedef uint8_t (*bt_gatt_discover_func_t)(struct bt_conn *conn,
                                        const struct bt_gatt_attr *attr,
                                        struct bt_gatt_discover_params *params);
 
enum {
        BT_GATT_DISCOVER_PRIMARY,
        BT_GATT_DISCOVER_SECONDARY,
        BT_GATT_DISCOVER_INCLUDE,
        BT_GATT_DISCOVER_CHARACTERISTIC,
        BT_GATT_DISCOVER_DESCRIPTOR,
        BT_GATT_DISCOVER_ATTRIBUTE,
        BT_GATT_DISCOVER_STD_CHAR_DESC,
};
 
struct bt_gatt_discover_params {
        const struct bt_uuid *uuid;
        bt_gatt_discover_func_t func;
        union {
                struct {
                        uint16_t attr_handle;
                        uint16_t start_handle;
                        uint16_t end_handle;
                } _included;
                uint16_t start_handle;
        };
        uint16_t end_handle;
        uint8_t type;
#if defined(CONFIG_BT_GATT_AUTO_DISCOVER_CCC)
        struct bt_gatt_subscribe_params *sub_params;
#endif /* defined(CONFIG_BT_GATT_AUTO_DISCOVER_CCC) */
#if defined(CONFIG_BT_EATT)
        enum bt_att_chan_opt chan_opt;
#endif /* CONFIG_BT_EATT */
};
 
int bt_gatt_discover(struct bt_conn *conn,
                     struct bt_gatt_discover_params *params);
 
struct bt_gatt_read_params;
 
typedef uint8_t (*bt_gatt_read_func_t)(struct bt_conn *conn, uint8_t err,
                                    struct bt_gatt_read_params *params,
                                    const void *data, uint16_t length);
 
struct bt_gatt_read_params {
        bt_gatt_read_func_t func;
        size_t handle_count;
        union {
                struct {
                        uint16_t handle;
                        uint16_t offset;
                } single;
                struct {
                        uint16_t *handles;
                        bool variable;
                } multiple;
                struct {
                        uint16_t start_handle;
                        uint16_t end_handle;
                        const struct bt_uuid *uuid;
                } by_uuid;
        };
#if defined(CONFIG_BT_EATT)
        enum bt_att_chan_opt chan_opt;
#endif /* CONFIG_BT_EATT */
};
 
int bt_gatt_read(struct bt_conn *conn, struct bt_gatt_read_params *params);
 
struct bt_gatt_write_params;
 
typedef void (*bt_gatt_write_func_t)(struct bt_conn *conn, uint8_t err,
                                     struct bt_gatt_write_params *params);
 
struct bt_gatt_write_params {
        bt_gatt_write_func_t func;
        uint16_t handle;
        uint16_t offset;
        const void *data;
        uint16_t length;
#if defined(CONFIG_BT_EATT)
        enum bt_att_chan_opt chan_opt;
#endif /* CONFIG_BT_EATT */
};
 
int bt_gatt_write(struct bt_conn *conn, struct bt_gatt_write_params *params);
 
int bt_gatt_write_without_response_cb(struct bt_conn *conn, uint16_t handle,
                                      const void *data, uint16_t length,
                                      bool sign, bt_gatt_complete_func_t func,
                                      void *user_data);
 
static inline int bt_gatt_write_without_response(struct bt_conn *conn,
                                                 uint16_t handle, const void *data,
                                                 uint16_t length, bool sign)
{
        return bt_gatt_write_without_response_cb(conn, handle, data, length,
                                                 sign, NULL, NULL);
}
 
struct bt_gatt_subscribe_params;
 
typedef uint8_t (*bt_gatt_notify_func_t)(struct bt_conn *conn,
                                      struct bt_gatt_subscribe_params *params,
                                      const void *data, uint16_t length);
 
typedef void (*bt_gatt_subscribe_func_t)(struct bt_conn *conn, uint8_t err,
                                         struct bt_gatt_subscribe_params *params);
 
enum {
        BT_GATT_SUBSCRIBE_FLAG_VOLATILE,
 
        BT_GATT_SUBSCRIBE_FLAG_NO_RESUB,
 
        BT_GATT_SUBSCRIBE_FLAG_WRITE_PENDING,
 
        BT_GATT_SUBSCRIBE_FLAG_SENT,
 
        BT_GATT_SUBSCRIBE_NUM_FLAGS
};
 
struct bt_gatt_subscribe_params {
        bt_gatt_notify_func_t notify;
        bt_gatt_subscribe_func_t subscribe;
 
        bt_gatt_write_func_t write;
        uint16_t value_handle;
        uint16_t ccc_handle;
#if defined(CONFIG_BT_GATT_AUTO_DISCOVER_CCC)
        uint16_t end_handle;
        struct bt_gatt_discover_params *disc_params;
#endif /* CONFIG_BT_GATT_AUTO_DISCOVER_CCC */
        uint16_t value;
#if defined(CONFIG_BT_SMP)
        bt_security_t min_security;
#endif
        ATOMIC_DEFINE(flags, BT_GATT_SUBSCRIBE_NUM_FLAGS);
 
        sys_snode_t node;
#if defined(CONFIG_BT_EATT)
        enum bt_att_chan_opt chan_opt;
#endif /* CONFIG_BT_EATT */
};
 
int bt_gatt_subscribe(struct bt_conn *conn,
                      struct bt_gatt_subscribe_params *params);
 
int bt_gatt_resubscribe(uint8_t id, const bt_addr_le_t *peer,
                        struct bt_gatt_subscribe_params *params);
 
int bt_gatt_unsubscribe(struct bt_conn *conn,
                        struct bt_gatt_subscribe_params *params);
 
void bt_gatt_cancel(struct bt_conn *conn, void *params);
 
#ifdef __cplusplus
}
#endif
 
#endif /* ZEPHYR_INCLUDE_BLUETOOTH_GATT_H_ */
```

## src/ndef_file_m.c
```c
/*
 * Copyright (c) 2018 Nordic Semiconductor ASA
 *
 * SPDX-License-Identifier: LicenseRef-Nordic-5-Clause
 */

/** @file
 *
 * @ingroup nfc_writable_ndef_msg_example_ndef_file_m ndef_file_m.c
 * @{
 * @ingroup nfc_writable_ndef_msg_example
 * @brief FLASH service for the NFC writable NDEF message example.
 *
 */

#include <zephyr/kernel.h>
#include <soc.h>
#include <zephyr/device.h>
#include <string.h>
#include <zephyr/fs/nvs.h>
#include <nfc/t4t/ndef_file.h>
#include <nfc/ndef/uri_msg.h>
#include <zephyr/storage/flash_map.h>

#include "ndef_file_m.h"

#define FLASH_URL_ADDRESS_ID 1 /**< Address of URL message in FLASH */

//static const uint8_t m_url[] = /**< Default NDEF message: URL "nordicsemi.com". */
//	{'n', 'o', 'r', 'd', 'i', 'c', 's', 'e', 'm', 'i', '.', 'c', 'o', 'm'};

static const char url1[] = "ik-polls-project.herokuapp.com/polls/deepthoughts";
static const char url2[] = "sites.google.com/view/group18finalproject/about-the-project";
static const char url3[] = "forms.gle/2ra6XanJvxNrh9xTA";
static const char url4[] = "forms.gle/Gs5diyMgjs6YHkmNA";
static const char* urls[] = { url1, url2, url3, url4 };

/* Flash partition for NVS */
#define NVS_FLASH_DEVICE FIXED_PARTITION_DEVICE(storage_partition)
/* Flash block size in bytes */
#define NVS_SECTOR_SIZE  (DT_PROP(DT_CHOSEN(zephyr_flash), erase_block_size))
#define NVS_SECTOR_COUNT 2
/* Start address of the filesystem in flash */
#define NVS_STORAGE_OFFSET FIXED_PARTITION_OFFSET(storage_partition)

static struct nvs_fs fs = {
	.sector_size = NVS_SECTOR_SIZE,
	.sector_count = NVS_SECTOR_COUNT,
	.offset = NVS_STORAGE_OFFSET,
};

int ndef_file_setup(void)
{
	int err;

	fs.flash_device = NVS_FLASH_DEVICE;
	if (fs.flash_device == NULL) {
		return -ENODEV;
	}

	err = nvs_mount(&fs);
	if (err < 0) {
		printk("Cannot initialize NVS!\n");
	}

	return err;
}

int ndef_file_update(int index, uint8_t const *buff, uint32_t size)
{
	/* Update FLASH file with new NDEF message. */
	return nvs_write(&fs, FLASH_URL_ADDRESS_ID+index*CONFIG_NDEF_FILE_SIZE, buff, size);
}

/** .. include_startingpoint_ndef_file_rst */
int ndef_file_default_message(int index, uint8_t *buff, uint32_t *size)
{
	int err;
	uint32_t ndef_size = nfc_t4t_ndef_file_msg_size_get(*size);

	/* Encode URI message into buffer. */
	err = nfc_ndef_uri_msg_encode(NFC_URI_HTTPS,
				      urls[index],
				      strlen(urls[index]),
				      nfc_t4t_ndef_file_msg_get(buff),
				      &ndef_size);
	if (err) {
		return err;
	}

	err = nfc_t4t_ndef_file_encode(buff, &ndef_size);
	if (err) {
		return err;
	}

	*size = ndef_size;

	return 0;
}
/** .. include_endpoint_ndef_file_rst */

int ndef_restore_default(int index, uint8_t *buff, uint32_t size)
{
	int err;

	err = ndef_file_default_message(index, buff, &size);
	if (err < 0) {
		printk("Cannot create default message!\n");
		return err;
	}

	/* Save record with default NDEF message. */
	err = ndef_file_update(index, buff, size);
	if (err < 0) {
		printk("Cannot flash NDEF message!\n");
	}
	return err;
}

int ndef_file_load(int index, uint8_t *buff, uint32_t size)
{
	int err;

	/* If there is no record with given ID, create default message and store
	 * in FLASH. FLASH_URL_ADDRESS_ID is used to store an address, lets see
	 * if we can read it from flash, since we don't know the size read the
	 * maximum possible
	 */
	err = nvs_read(&fs, FLASH_URL_ADDRESS_ID+index*CONFIG_NDEF_FILE_SIZE, buff, size);
	if (err > 0) { /* Item was found, show it */
		printk("Found NDEF file record.\n");
	} else {
		printk("NDEF file record not found, creating default NDEF.\n");
		/* Create default NDEF message. */
		err = ndef_restore_default(index, buff, size);
	}

	return err;
}

/** @} */
```

## src/ndef_file_m.h
```c
/*
 * Copyright (c) 2018 Nordic Semiconductor ASA
 *
 * SPDX-License-Identifier: LicenseRef-Nordic-5-Clause
 */

#ifndef _NDEF_FILE_M_H__
#define _NDEF_FILE_M_H__

/** @file
 *
 * @defgroup nfc_writable_ndef_msg_example_ndef_file_m ndef_file_m.h
 * @{
 * @ingroup nfc_writable_ndef_msg_example
 * @brief FLASH service for the NFC writable NDEF message example.
 *
 */

#include <zephyr/types.h>

/**
 * @brief   Function for initializing the NVS module.
 *
 * @return 0 when module has been set up properly,
 * error code otherwise.
 */
int ndef_file_setup(void);

/**
 * @brief   Function for updating NDEF message in the flash file.
 *
 * @details NVS update operation is performed on main loop.
 *
 * @param buff Pointer to the NDEF message to be stored in flash.
 * @param size Size of NDEF message.
 *
 * @return  0 when update request has been added to the queue.
 *          Otherwise, error code.
 */
int ndef_file_update(int index, uint8_t const *buff, uint32_t size);

/**
 * @brief Function for loading NDEF message from the flash file.
 *
 * @details If the record does not exist, the default NDEF message
 * is created and stored in flash.
 *
 * @param buff Pointer to the buffer for NDEF message.
 * @param size Size of the buffer.
 *
 * @return  0 when NDEF message has been retrieved properly. Otherwise error
 * code is returned.
 */
int ndef_file_load(int index, uint8_t *buff, uint32_t size);

/**
 * @brief Function for creating the default NDEF message: URL "nordicsemi.com".
 *
 * @param buff Pointer to the NDEF message buffer.
 * @param size Pointer to the variable holding buffer size as input, size
 * of the created message as output.
 *
 * @return 0 if the message has been created, error code otherwise.
 */
int ndef_file_default_message(int index, uint8_t *buff, uint32_t *size);

/**
 * @brief Function for creating and storing the default NDEF message:
 * URL "nordicsemi.com".
 *
 * @param buff Pointer to the NDEF message buffer.
 * @param size Pointer to the variable holding buffer size as input, size
 * of the created message as output.
 *
 * @return 0 if the message has been created, error code otherwise.
 */
int ndef_restore_default(int index, uint8_t *buff, uint32_t size);

/** @} */

#endif /* _NDEF_FILE_M_H__ */
```
